## boards/shields/eidolon/Kconfig.defconfig
```kconfig
# Copyright (c) 2026 Jonny Irwin
# SPDX-License-Identifier: MIT

if SHIELD_EIDOLON_LEFT

config ZMK_KEYBOARD_NAME
	default "Eidolon"

config ZMK_SPLIT_ROLE_CENTRAL
	default y

endif

if SHIELD_EIDOLON_LEFT || SHIELD_EIDOLON_RIGHT

config ZMK_SPLIT
	default y

endif
```

## boards/shields/eidolon/Kconfig.shield
```kconfig
# Copyright (c) 2026 Jonny Irwin
# SPDX-License-Identifier: MIT

config SHIELD_EIDOLON_LEFT
	def_bool $(shields_list_contains,eidolon_left)

config SHIELD_EIDOLON_RIGHT
	def_bool $(shields_list_contains,eidolon_right)
```
